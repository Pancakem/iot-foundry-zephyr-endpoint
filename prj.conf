## CMakeLists.txt
```
# Copyright (c) 2026 PICMG

cmake_minimum_required(VERSION 3.20.0)

find_package(Zephyr REQUIRED HINTS $ENV{ZEPHYR_BASE})

project(iot_foundry_zephyr_endpoint)

# zephyr_syscall_include_directories(include)
zephyr_include_directories(include)

# Option to include PLDM support (use -DINCLUDE_PLDM=ON to enable)
option(INCLUDE_PLDM "Enable building and linking libpldm" OFF)

message(STATUS "INCLUDE_PLDM=${INCLUDE_PLDM}")

target_sources(app PRIVATE src/main.c src/mctp_control.c)

# Option to build host-only tools (like iot_builder). Disabled by default.
option(BUILD_HOST_TOOLS "Build host-only tools (not for cross/Zephyr builds)" OFF)

if(INCLUDE_PLDM)
  # Expose the option to the C compiler so `#ifdef INCLUDE_PLDM` works
  target_compile_definitions(app PRIVATE INCLUDE_PLDM=1)
  # Prefer a lightweight CMake wrapper shipped in the superproject that
  # compiles selected libpldm sources. If not present, fall back to the
  # upstream `pldm` directory (which uses Meson and may not be usable here).
  if(EXISTS "${CMAKE_CURRENT_SOURCE_DIR}/pldm-cmake/CMakeLists.txt")
    add_subdirectory("${CMAKE_CURRENT_SOURCE_DIR}/pldm-cmake")
  elseif(EXISTS "${CMAKE_CURRENT_SOURCE_DIR}/pldm/CMakeLists.txt")
    add_subdirectory("${CMAKE_CURRENT_SOURCE_DIR}/pldm")
  endif()

  if(TARGET libpldm)
    target_link_libraries(app PRIVATE libpldm)
  elseif(TARGET pldm)
    target_link_libraries(app PRIVATE pldm)
  endif()

  # Add platform handler sources and FRU implementation into the Zephyr app
  # when PLDM support is enabled. Use CONFIGURE_DEPENDS so CMake re-globs
  # when files are added/removed during development.
  file(GLOB PLATFORM_SRCS CONFIGURE_DEPENDS
    ${CMAKE_CURRENT_SOURCE_DIR}/src/process_pldm.c
    ${CMAKE_CURRENT_SOURCE_DIR}/src/platform_*.c
    ${CMAKE_CURRENT_SOURCE_DIR}/src/fru.c
    ${CMAKE_CURRENT_SOURCE_DIR}/src/build_timestamp.c
  )
  if(PLATFORM_SRCS)
    target_sources(app PRIVATE ${PLATFORM_SRCS})
  endif()
endif()

# after project(...) include the platform-specific PDR source files
if(INCLUDE_PLDM)
    file(GLOB PDR_SRCS CONFIGURE_DEPENDS ${CMAKE_CURRENT_SOURCE_DIR}/src/pdrs/*.c)
    if(PDR_SRCS)
    target_sources(app PRIVATE ${PDR_SRCS})
    endif()
endif()

# If requested, build host tools (iot_builder) for native Linux only
if(BUILD_HOST_TOOLS AND NOT CMAKE_CROSSCOMPILING)
  if(EXISTS "${CMAKE_CURRENT_SOURCE_DIR}/tools/iot_builder/CMakeLists.txt")
    add_subdirectory(${CMAKE_CURRENT_SOURCE_DIR}/tools/iot_builder ${CMAKE_BINARY_DIR}/tools/iot_builder_build)
    if(TARGET iot_builder)
      # Ensure the Zephyr app depends on generator outputs if the tool provides a gen target
      if(TARGET iot_builder_gen)
        add_dependencies(app iot_builder_gen)
      endif()
    endif()
  endif()
endif()
```

## west.yml
```
manifest:
  remotes:
    - name: zephyrproject-rtos
      url-base: https://github.com/zephyrproject-rtos

  projects:
    - name: zephyr
      remote: zephyrproject-rtos
      revision: v4.3.0
      import:
        name-allowlist:
          - libmctp
          - hal_atmel
          - cmsis_6
```

## prj.conf
```kconfig
CONFIG_SERIAL=y
CONFIG_UART_ASYNC_API=y
CONFIG_MCTP=y
CONFIG_MCTP_UART=y
CONFIG_LOG=y
CONFIG_LOG_BUFFER_SIZE=1024
CONFIG_ISR_STACK_SIZE=4096

# Reduce global log verbosity: hide debug-level messages (LOG_DBG)
# Levels: 0=NONE,1=ERR,2=WRN,3=INF,4=DBG
CONFIG_LOG_DEFAULT_LEVEL=3
```

## boards/arduino_nano_33_iot.conf
```kconfig
# Board-specific defaults for logging on CDC-ACM and MCTP on sercom5
# Enable USB device and CDC-ACM for the console/logging
CONFIG_USB_DEVICE_STACK_NEXT=y
CONFIG_USBD_CDC_ACM_CLASS=y
CONFIG_CDC_ACM_SERIAL_INITIALIZE_AT_BOOT=y

# Keep legacy USB device stack disabled; use `device_next` (USBD_) stack
CONFIG_USB_DEVICE_STACK=n

# Route console/shell to the chosen devicetree console (overlay sets CDC-ACM)
CONFIG_CONSOLE=y
CONFIG_PRINTK=y
CONFIG_STDOUT_CONSOLE=y

# MCTP + UART async support (used by mctp_uart binding)
CONFIG_SERIAL=y
CONFIG_USBD_CDC_ACM_WORKQUEUE=y
CONFIG_USBD_CDC_ACM_BUF_POOL=y
CONFIG_DMA=y
CONFIG_DMA_SAM0=y
CONFIG_UART_ASYNC_API=y
CONFIG_UART_SAM0_ASYNC=y
## Reduce DMA driver verbosity: avoid debug spam from dma_sam0
# Set to ERR to still surface real problems
CONFIG_DMA_LOG_LEVEL_ERR=y
CONFIG_UART_INTERRUPT_DRIVEN=y
CONFIG_MCTP=y
CONFIG_MCTP_UART=y

# Logging buffer and ISR stack tuning
CONFIG_LOG=y
CONFIG_UDC_DRIVER_LOG_LEVEL_ERR=y
CONFIG_USBD_LOG_LEVEL_ERR=y
CONFIG_USBD_CDC_ACM_LOG_LEVEL_OFF=y
CONFIG_LOG_DEFAULT_LEVEL=3
CONFIG_LOG_BUFFER_SIZE=4096
CONFIG_KERNEL_LOG_LEVEL_INF=y
CONFIG_UART_LOG_LEVEL_DBG=y
# Use a smaller ISR stack to reduce noinit memory usage on SAMD21
CONFIG_ISR_STACK_SIZE=1024

# Enable the CDC-ACM serial backend at boot so the USB serial port
# is brought up early and can drain log output.
CONFIG_CDC_ACM_SERIAL_ENABLE_AT_BOOT=y
```

## boards/nrf54l15dk_nrf54l15_cpuapp.conf
```kconfig
CONFIG_CONSOLE=y
CONFIG_PRINTK=y
CONFIG_STDOUT_CONSOLE=y

# MCTP + UART async support (used by mctp_uart binding)
CONFIG_SERIAL=y
CONFIG_DMA=y
CONFIG_UART_ASYNC_API=y
CONFIG_DMA_LOG_LEVEL_DBG=y
CONFIG_UART_INTERRUPT_DRIVEN=y
CONFIG_MCTP=y
CONFIG_MCTP_UART=y

# Logging buffer and ISR stack tuning
CONFIG_LOG=y
CONFIG_UDC_DRIVER_LOG_LEVEL_ERR=y
CONFIG_LOG_DEFAULT_LEVEL=4
CONFIG_LOG_BUFFER_SIZE=4096
CONFIG_KERNEL_LOG_LEVEL_INF=y
CONFIG_UART_LOG_LEVEL_DBG=y
```

## boards/nrf54l15dk_nrf54l15_cpuapp.overlay
```dts
arduino_serial: &uart30 {
    status = "okay";
};

&uart20 {
    status = "okay";
};
```

## src/main.c
```c
/**
 * @file main.c
 * @brief Zephyr Endpoint for IoT-Foundry project
 * This is a simple MCTP endpoint implementation using Zephyr RTOS.
 * It uses MCTP over UART for communication and handles basic
 * MCTP control messages such as Get Endpoint ID.
 * @author Doug Sandy
 * @date January 2026
 */

#include <stdlib.h>
#include <stdio.h>
#include <assert.h>
#include <zephyr/kernel.h>
#include <zephyr/types.h>
#include <zephyr/pmci/mctp/mctp_uart.h>
#include <libmctp.h>
#include <zephyr/drivers/uart.h>
#include <zephyr/devicetree.h>
#include <zephyr/drivers/gpio.h>
#include <zephyr/logging/log.h>
#include "mctp_control.h"
#include "process_pldm.h"

LOG_MODULE_REGISTER(mctp_endpoint, LOG_LEVEL_DBG);

/* Duplicate of libmctp control header structures/macros.
 * These are intentionally local copies for development/testing when
 * the upstream libmctp headers are not available on the include path.
 */
struct mctp_ctrl_msg_hdr {
	uint8_t ic_msg_type;
	uint8_t rq_dgram_inst;
	uint8_t command_code;
} __packed;

#define MCTP_CTRL_HDR_MSG_TYPE	       0
#define MCTP_CTRL_HDR_FLAG_REQUEST     (1 << 7)
#define MCTP_CTRL_HDR_FLAG_DGRAM       (1 << 6)
#define MCTP_CTRL_HDR_INSTANCE_ID_MASK 0x1F

#define ECHO_Q_DEPTH 4
#define RX_BUF_SZ 256

struct echo_msg {
	uint8_t remote_eid;
	uint8_t destination_eid;
	bool tag_owner;
	uint8_t msg_tag;
	size_t len;
	uint8_t data[RX_BUF_SZ];
};

// message queue for received echo messages
K_MSGQ_DEFINE(echo_q, sizeof(struct echo_msg), ECHO_Q_DEPTH, 4);

// define the MCTP UART binding
MCTP_UART_DT_DEFINE(mctp_endpoint, DEVICE_DT_GET(DT_NODELABEL(arduino_serial)));

/**
 * @brief MCTP receive message handler
 * Handles incoming MCTP messages by enqueueing them for processing.
 * @param remote_eid The source endpoint ID of the message sender.
 * @param tag_owner The tag owner bit of the message.
 * @param msg_tag The message tag of the message.
 * @param data Pointer to user data (not used).
 * @param msg Pointer to the full message including header.
 * @param len Length of the message in bytes.
 */
static void rx_message(uint8_t remote_eid, bool tag_owner, uint8_t msg_tag, void *data, void *msg, size_t len)
{
	struct echo_msg emsg;

	// ignore non requests
	if (!tag_owner) {
		return;
	}

	emsg.remote_eid = remote_eid;
	emsg.tag_owner = !tag_owner; /* reply toggles tag owner */
	emsg.msg_tag = msg_tag;
	emsg.len = MIN(len, (size_t)RX_BUF_SZ);
	if (msg && emsg.len) {
		memcpy(emsg.data, msg, emsg.len);
	}

	k_msgq_put(&echo_q, &emsg, K_NO_WAIT); 
}

/**
 * @brief Main function
 * Initializes MCTP over UART and enters the main processing loop.
 */
int main(void)
{
	LOG_INF("mctp_endpoint: main() start");

	mctp_set_alloc_ops(malloc, free, realloc);
	
	struct mctp *mctp_ctx = mctp_init(); 
	__ASSERT_NO_MSG(mctp_ctx != NULL);

	// set the mctp bus binding for our uart - initial EID 0x00 (unconfigured)
	mctp_register_bus(mctp_ctx, &mctp_endpoint.binding, 0x00);
	
	// set the default rx message handler
	mctp_set_rx_all(mctp_ctx, rx_message, NULL);

	/* MCTP poll loop: dequeue echo messages and send replies from thread context */
	mctp_uart_start_rx(&mctp_endpoint);

#ifdef INCLUDE_PLDM
	init_pldm();
#endif

	struct echo_msg em;
	while (true) {
		if (k_msgq_get(&echo_q, &em, K_FOREVER) == 0) {
			LOG_DBG("dequeued echo for eid %d len %zu tag %u", em.remote_eid, em.len, em.msg_tag);
		
			const struct mctp_ctrl_msg_hdr *hdr = (const struct mctp_ctrl_msg_hdr *)em.data;
			if ((em.len >= sizeof(struct mctp_ctrl_msg_hdr)) && 
				(hdr->ic_msg_type == MCTP_CTRL_HDR_MSG_TYPE)) {
				// this is a control message - process it
				LOG_DBG("Control message: type %u", hdr->command_code);
				int ret = send_control_message(mctp_ctx, em.remote_eid, em.tag_owner, em.msg_tag, em.data, em.len);
				if (ret) {
					LOG_DBG("send_control_message failed: %d", ret);
				}
			} 
			// process pldm messages if libpldm is included
#ifndef INCLUDE_PLDM
			else if ((em.len >= sizeof(struct mctp_ctrl_msg_hdr)) && 
				(hdr->ic_msg_type == MCTP_PLDM_HDR_MSG_TYPE)) {
				// this is a PLDM message - process it
				int ret = handle_pldm_message(mctp_ctx, em.remote_eid, em.tag_owner, em.msg_tag, em.data, em.len);
				if (ret) {
					LOG_DBG("send_control_message failed: %d", ret);
				}
			}
#endif
			else {
				LOG_WRN("unknown message type, dropping");
				continue;
			}			
		}
	}

	return 0;
}
```

## src/fru.c
```c
#include <zephyr/types.h>
#include <libmctp.h>
#include <zephyr/logging/log.h>
#include <zephyr/kernel.h>
#include <string.h>
#include <libpldm/base.h>
#include <libpldm/platform.h>
#include <libpldm/control.h>
#include <libpldm/fru.h>
#include <libpldm/pdr.h>
#include <../pldm/src/control-internal.h>
#include "pdrs/config.h"
#include "mctp_control.h"

int fru_get_metadata(struct pldm_header_info *hdr, const void *req_msg, size_t req_len, void *resp, size_t *resp_len) 
{
	// TODO: implement
	return PLDM_ERROR_UNSUPPORTED_PLDM_CMD;
}

int fru_get_record_table(struct pldm_header_info *hdr, const void *req_msg, size_t req_len, void *resp, size_t *resp_len)
{
	// TODO: implement
	return PLDM_ERROR_UNSUPPORTED_PLDM_CMD;
}

int fru_set_record_table(struct pldm_header_info *hdr, const void *req_msg, size_t req_len, void *resp, size_t *resp_len)
{
	// TODO: implement
	return PLDM_ERROR_UNSUPPORTED_PLDM_CMD;
}

int fru_get_record_by_option(struct pldm_header_info *hdr, const void *req_msg, size_t req_len, void *resp, size_t *resp_len)
{
	// TODO: implement
	return PLDM_ERROR_UNSUPPORTED_PLDM_CMD;
}
```

## src/mctp_control.c
```c
/**
 * @file mctp_control.c
 * @brief MCTP Control Message handling for Zephyr MCTP Endpoints.
 * 
 * This file implements the handling of MCTP control messages
 * such as Set Endpoint ID, Get Endpoint ID, Get MCTP Version Support, 
 * and Get Message Type Support.
 * It provides functions to process incoming control messages
 * and send appropriate responses.
 * 
 * @author Doug Sandy
 * @date January 2026
 * 
 */
#include <stdio.h>
#include <zephyr/types.h>
#include <libmctp.h>
#include <zephyr/logging/log.h>
#include <zephyr/kernel.h>
#include <string.h>
#include "mctp_control.h"

LOG_MODULE_REGISTER(mctp_control, LOG_LEVEL_DBG);


// structures for maintaining supported versions per message type
#ifndef MCTP_MAX_MSG_TYPES
#define MCTP_MAX_MSG_TYPES 4
#endif

#ifndef MCTP_MAX_VERSIONS_PER_TYPE
#define MCTP_MAX_VERSIONS_PER_TYPE 8
#endif

struct mctp_versions_entry {
    uint8_t used;
    uint8_t msg_type;
    struct mctp_version_entry entries[MCTP_MAX_VERSIONS_PER_TYPE];
    size_t count;
};

static bool mctp_versions_initialized = false;
static struct mctp_versions_entry mctp_versions_map[MCTP_MAX_MSG_TYPES];

// Control message request/response structures
struct control_msg_request {
    uint8_t ic_msg_type;
    uint8_t rq_dgram_inst;
    uint8_t command_code;
} __packed;

struct set_endpoint_id_request {
    uint8_t ic_msg_type;
    uint8_t rq_dgram_inst;
    uint8_t command_code;
    uint8_t operation;
    uint8_t endpoint_id;
} __packed;

struct set_endpoint_id_response {
    uint8_t ic_msg_type;
    uint8_t rq_dgram_inst;
    uint8_t command_code;
    uint8_t completion_code;
    uint8_t status;
    uint8_t eid_setting;
    uint8_t eid_pool_size;
} __packed;

struct get_endpoint_id_request {
    uint8_t ic_msg_type;
    uint8_t rq_dgram_inst;
    uint8_t command_code;
} __packed;

struct get_endpoint_id_response {
    uint8_t ic_msg_type;
    uint8_t rq_dgram_inst;
    uint8_t command_code;
    uint8_t completion_code;
    uint8_t endpoint_id;
    uint8_t endpoint_type;
    uint8_t medium_specific;
} __packed;

struct get_mctp_version_support_request {
    uint8_t ic_msg_type;
    uint8_t rq_dgram_inst;
    uint8_t command_code;
    uint8_t msg_type;
} __packed;

struct get_mctp_version_support_response {
    uint8_t ic_msg_type;
    uint8_t rq_dgram_inst;
    uint8_t command_code;
    uint8_t completion_code;
    uint8_t version_number_entry_count;
    struct mctp_version_entry versions[MCTP_MAX_VERSIONS_PER_TYPE];
} __packed;

struct get_message_type_support_request {
    uint8_t ic_msg_type;
    uint8_t rq_dgram_inst;
    uint8_t command_code;
} __packed;

struct get_message_type_support_response {
    uint8_t ic_msg_type;
    uint8_t rq_dgram_inst;
    uint8_t command_code;
    uint8_t completion_code;
    uint8_t type_count;
    uint8_t types[MCTP_MAX_MSG_TYPES];
} __packed;

struct control_completion_response {
    uint8_t ic_msg_type;
    uint8_t rq_dgram_inst;
    uint8_t command_code;
    uint8_t completion_code;
} __packed;

/**
 * TODO:
 * the currently version of libmctp supported by zephyr does not include a mechanism to
 * set the eid of a bus without releasing and re-registering the bus.  For control messages
 * that need to report/change the current eid, we need access to the mctp struct.  For now, we
 * duplicated the relevant mctp struct definitions here to allow access to the eid field.
 * This should be removed when libmctp is updated to include a proper API for this. 
 */
/* When running the posix unit test build the minimal `struct mctp` and
 * access macros are provided by `mctp_control.h`. Avoid redefining them
 * here to prevent duplicate-definition errors.
 */
#ifndef MCTP_POSIX_UNIT_TEST
struct mctp_bus {
    mctp_eid_t eid;
};

struct mctp {
    int n_busses;
    struct mctp_bus *busses;
};

// Macro to get/set EID from/in mctp struct
/* TODO - update, but don't replace when libmctp is updated */
#define GET_EID_FROM_MCTP(mctp_ptr) (((struct mctp_bus *)(mctp_ptr->busses))->eid)
#define SET_EID_IN_MCTP(mctp_ptr, new_eid) ((((struct mctp_bus *)(mctp_ptr->busses))->eid) = (new_eid))
/* end TODO */
#endif /* MCTP_POSIX_UNIT_TEST */

/**
 * @brief Send a completion response message.
 * 
 * Constructs and sends a completion response message
 * with the specified parameters.
 * 
 * @param mctp Pointer to the MCTP instance.
 * @param remote_eid The destination endpoint ID for the response.
 * @param tag_owner The tag owner bit for the response.
 * @param msg_tag The message tag for the response.
 * @param command_code The command code of the original request.
 * @param completion_code The completion code to include in the response.
 */
void send_completion_response(struct mctp *mctp, uint8_t remote_eid, bool tag_owner, uint8_t msg_tag, const void *msg, size_t len, uint8_t completion_code) {
    if (len<sizeof(struct control_msg_request)) {
        // silently drop packet
        return;
    }
    struct control_msg_request *req = (struct control_msg_request *)msg;
    struct control_completion_response resp;
    resp.ic_msg_type = req->ic_msg_type;
    resp.rq_dgram_inst = req->rq_dgram_inst & ~0x80;  // clear request bit
    resp.command_code = req->command_code;
    resp.completion_code = completion_code;

    // send the response
    mctp_message_tx(mctp, remote_eid, !tag_owner, msg_tag,
                    &resp, sizeof(struct control_completion_response));        
}

/**
 * @brief Initialize the MCTP versions map with default entries.
 * 
 * This function populates the versions map with predefined
 * version entries for supported MCTP message types.
 * 
 * This function is called internally to set up the initial state
 * of the versions map before any other operations are performed.
 */
static void initialize_versions_map(void)
{
    for (size_t i = 0; i < MCTP_MAX_MSG_TYPES; i++) {
        mctp_versions_map[i].used = 0;
        mctp_versions_map[i].count = 0;
    }
    mctp_versions_initialized = true;

    mctp_versions_map_add(0x00, &(struct mctp_version_entry){ .major_version = 0xf1, .minor_version = 0xf0, .update_version = 0xff, .alpha_version = 0 });
    mctp_versions_map_add(0x00, &(struct mctp_version_entry){ .major_version = 0xf1, .minor_version = 0xf1, .update_version = 0xff, .alpha_version = 0 });
    mctp_versions_map_add(0x00, &(struct mctp_version_entry){ .major_version = 0xf1, .minor_version = 0xf2, .update_version = 0xff, .alpha_version = 0 });
    mctp_versions_map_add(0x00, &(struct mctp_version_entry){ .major_version = 0xf1, .minor_version = 0xf3, .update_version = 0xf1, .alpha_version = 0 });
}

/**
 * @brief Add a version entry for a given MCTP message type.
 * 
 * Adds the specified version entry to the versions map
 * 
 * @param msg_type The MCTP message type to add the version for.
 * @param ver Pointer to the version entry to add.
 * @return int 0 on success, -1 on failure (no slot or capacity).
 */
int mctp_versions_map_add(uint8_t msg_type, const struct mctp_version_entry *ver)
{
    if (!ver) return -1;

    if (!mctp_versions_initialized) {
        initialize_versions_map();
        mctp_versions_initialized = true;
    }

    /* find existing */
    int idx = -1;
    for (size_t i = 0; i < MCTP_MAX_MSG_TYPES; i++) {
        if (mctp_versions_map[i].used && mctp_versions_map[i].msg_type == msg_type) {
            idx = (int)i;
            break;
        }
    }

    /* create new slot if not found */
    if (idx < 0) {
        for (size_t i = 0; i < MCTP_MAX_MSG_TYPES; i++) {
            if (!mctp_versions_map[i].used) {
                mctp_versions_map[i].used = 1;
                mctp_versions_map[i].msg_type = msg_type;
                mctp_versions_map[i].count = 0;
                idx = (int)i;
                break;
            }
        }
    }

    if (idx < 0) 
        return -1; /* no slot available */

    if (mctp_versions_map[idx].count >= MCTP_MAX_VERSIONS_PER_TYPE) 
        return -1; /* full */

    mctp_versions_map[idx].entries[mctp_versions_map[idx].count++] = *ver;
    return 0;
}

/**
 * @brief Retrieve the versions entry for a given MCTP message type.
 * 
 * Searches the versions map for the specified message type
 * and returns a pointer to the corresponding versions entry.
 * 
 * @param msg_type The MCTP message type to look up.
 * @return struct mctp_versions_entry* Pointer to the versions entry if found, NULL otherwise.
 */
struct mctp_versions_entry *mctp_versions_map_get(uint8_t msg_type)
{
    if (!mctp_versions_initialized) {
        initialize_versions_map();
        mctp_versions_initialized = true;
    }

    for (size_t i = 0; i < MCTP_MAX_MSG_TYPES; i++) {
        if (mctp_versions_map[i].used && mctp_versions_map[i].msg_type == msg_type) {
            return &mctp_versions_map[i];
        }
    }
    return NULL;
}

/**
 * @brief Handle a Set Endpoint ID control request.
 *
 * Attempts to set the endpoint ID as requested in the message payload.
 * Sends a response indicating success or failure.
 * 
 * @param mctp Pointer to the MCTP instance.
 * @param remote_eid The source endpoint ID of the message sender.
 * @param tag_owner The tag owner bit of the message.
 * @param msg_tag The message tag of the message.
 * @param data Pointer to the message payload.
 * @param msg Pointer to the full message including header.
 * @param len Length of the message in bytes.
 * @return int CONTROL_COMPLETE_SUCCESS on success, error code otherwise.
 */
static int process_set_endpoint_id_control_message(struct mctp *mctp, uint8_t remote_eid, bool tag_owner, uint8_t msg_tag, const void *msg, uint16_t len) {
    const struct set_endpoint_id_request *req = (const struct set_endpoint_id_request *)msg;
    if (len < sizeof(struct set_endpoint_id_request)) {
        return CONTROL_COMPLETE_INVALID_LENGTH;
    }

    // get the requested endpoint id from the message payload
    if ((req->operation & 0x03) == 0x02) {
        // this is a request to reset static EID value.  Since this endpoint does
        // not support static ID values, the proper response is to send an
        // ERROR_INVALID_DATA response
        return CONTROL_COMPLETE_INVALID_DATA;
    } 
    if ((req->operation & 0x03) == 0x03) {
        // this is a request to set discovery flag.  Since this endpoint does
        // not support discovery flag, the proper response is to send an
        // ERROR_INVALID_DATA response
        return CONTROL_COMPLETE_INVALID_DATA;
    } 
    if ((req->endpoint_id == MCTP_EID_NULL) || (req->endpoint_id == MCTP_EID_BROADCAST)) {
        return CONTROL_COMPLETE_INVALID_DATA;
    } 

    // attempt to set the endpoint ID
    SET_EID_IN_MCTP(mctp, req->endpoint_id);
    LOG_INF("Set Endpoint ID to %u", req->endpoint_id);

    // message body for response
    struct set_endpoint_id_response resp;
    resp.ic_msg_type = req->ic_msg_type;
    resp.rq_dgram_inst = req->rq_dgram_inst & ~0x80;  // clear request bit
    resp.command_code = req->command_code;
    resp.completion_code = CONTROL_COMPLETE_SUCCESS;
    resp.eid_setting = req->endpoint_id;
    resp.status = 0x00;
    resp.eid_pool_size = 0x00;

    // send the response
    mctp_message_tx(mctp, remote_eid, !tag_owner, msg_tag,
                    &resp, sizeof(struct set_endpoint_id_response));        
    LOG_INF("sent Set Endpoint ID response");

    return CONTROL_COMPLETE_SUCCESS;
}

/**
 * @brief Handle a Get Endpoint ID control request.
 *
 * Responds with the current endpoint ID and type.
 * 
 * @param mctp Pointer to the MCTP instance.
 * @param remote_eid The source endpoint ID of the message sender.
 * @param tag_owner The tag owner bit of the message.
 * @param msg_tag The message tag of the message.
 * @param msg Pointer to the full message including header.
 * @param len Length of the message in bytes.
 * @return int CONTROL_COMPLETE_SUCCESS on success, error code otherwise.
 */
static int process_get_endpoint_id_control_message(struct mctp *mctp, uint8_t remote_eid, bool tag_owner, uint8_t msg_tag, const void *msg, uint16_t len) {
    if (len < sizeof(struct get_endpoint_id_request)) {
        return CONTROL_COMPLETE_INVALID_LENGTH;
    }
    const struct get_endpoint_id_request *req = (const struct get_endpoint_id_request *)msg;

    // message body for response
    struct get_endpoint_id_response resp;
    resp.ic_msg_type = req->ic_msg_type;
    resp.rq_dgram_inst = req->rq_dgram_inst & ~0x80;  // clear request bit
    resp.command_code = req->command_code;
    resp.completion_code = CONTROL_COMPLETE_SUCCESS;
    resp.endpoint_id = GET_EID_FROM_MCTP(mctp);
    resp.endpoint_type = 0x00;   // simple, dynamic endpoint
    resp.medium_specific = 0x00; // no medium specific info

    // send the response
    mctp_message_tx(mctp, remote_eid, !tag_owner, msg_tag,
                    &resp, sizeof(struct get_endpoint_id_response));        
    return CONTROL_COMPLETE_SUCCESS;
}

/**
 * @brief Handle a Get MCTP Version Support control request.
 *
 * Determines the supported version(s) for the requested message type
 * and constructs a response containing version entries.
 *
 * @param mctp Pointer to the MCTP instance.
 * @param remote_eid The source endpoint ID of the message sender.
 * @param tag_owner The tag owner bit of the message.
 * @param msg_tag The message tag of the message.
 * @param msg Pointer to the full message including header.
 * @param len Length of the message in bytes.
 * @return int CONTROL_COMPLETE_SUCCESS on success, error code otherwise.
 */
static int process_get_mctp_version_support_control_message(struct mctp *mctp, uint8_t remote_eid, bool tag_owner, uint8_t msg_tag, const void *msg, uint16_t len) {
    if (len < sizeof(struct get_mctp_version_support_request)) {
        return CONTROL_COMPLETE_INVALID_LENGTH;
    }
    const struct get_mctp_version_support_request *req = (const struct get_mctp_version_support_request *)msg;

    struct mctp_versions_entry *versions;
    if (req->msg_type==0xff) {
        // version entries for base mctp spec (for us it is the same as control)
        versions = mctp_versions_map_get(0x00);
    } else {
        versions = mctp_versions_map_get(req->msg_type);
    }
    
    if (!versions) {
        // no versions found for requested message type
        return CONTROL_COMPLETE_INVALID_DATA;
    }

    // message body for response
    struct get_mctp_version_support_response resp;
    resp.ic_msg_type = req->ic_msg_type;
    resp.rq_dgram_inst = req->rq_dgram_inst & ~0x80;  // clear request bit
    resp.command_code = req->command_code;
    resp.completion_code = CONTROL_COMPLETE_SUCCESS;
    resp.version_number_entry_count = versions->count;
    for (size_t i = 0; i < versions->count; i++) {
        resp.versions[i] = versions->entries[i];
    }

    // send the response
    mctp_message_tx(mctp, remote_eid, !tag_owner, msg_tag,
                    &resp, sizeof(struct get_mctp_version_support_response)-
                          (MCTP_MAX_VERSIONS_PER_TYPE - versions->count) * sizeof(struct mctp_version_entry));        

    return CONTROL_COMPLETE_SUCCESS;
}

/**
 * @brief Handle a Get Message Type Support control request.
 *
 * Responds with a list of MCTP message types supported by this
 * endpoint (control, PLDM if enabled, etc.).
 *
 * @param mctp Pointer to the MCTP instance.
 * @param remote_eid The source endpoint ID of the message sender.
 * @param tag_owner The tag owner bit of the message.
 * @param msg_tag The message tag of the message.
 * @param msg Pointer to the full message including header.
 * @param len Length of the message in bytes.
 * @return int CONTROL_COMPLETE_SUCCESS on success, error code otherwise.
 */
int process_get_message_type_support_control_message(struct mctp *mctp, uint8_t remote_eid, bool tag_owner, uint8_t msg_tag, const void *msg, uint16_t len) {
    if (len < sizeof(struct get_message_type_support_request)) {
        return CONTROL_COMPLETE_INVALID_LENGTH;
    }
    const struct get_message_type_support_request *req = (const struct get_message_type_support_request *)msg;

    // message body for response
    struct get_message_type_support_response resp;
    resp.ic_msg_type = req->ic_msg_type;
    resp.rq_dgram_inst = req->rq_dgram_inst & ~0x80;  // clear request bit
    resp.command_code = req->command_code;
    resp.completion_code = CONTROL_COMPLETE_SUCCESS;
    
    if (!mctp_versions_initialized) {
        initialize_versions_map();
        mctp_versions_initialized = true;
    }
    resp.type_count = 0;
    for (int i = 0; i < MCTP_MAX_MSG_TYPES; i++) {
        if (mctp_versions_map[i].used) {
            resp.types[resp.type_count++] = mctp_versions_map[i].msg_type;
        }
    }

    // send the response
    mctp_message_tx(mctp, remote_eid, !tag_owner, msg_tag,
                    &resp, sizeof(struct get_message_type_support_response)-
                          (MCTP_MAX_MSG_TYPES - resp.type_count) * sizeof(uint8_t));        

    return CONTROL_COMPLETE_SUCCESS;
}

/**
 * @brief Process an incoming MCTP control message.
 * 
 * Dispatches the control message to the appropriate handler based
 * on the command code in the message header.  
 * 
 * @param remote_eid The source endpoint ID of the message sender.
 * @param tag_owner The tag owner bit of the message.
 * @param msg_tag The message tag of the message.
 * @param msg Pointer to the full message including header.
 * @param len Length of the message in bytes.
 */
int send_control_message(struct mctp *mctp, uint8_t eid, bool tag_owner, uint8_t msg_tag, const void *msg, size_t msg_len)
{
    const struct control_msg_request *hdr = (const struct control_msg_request *)msg;
    if (msg_len < sizeof(struct control_msg_request)) {
        LOG_ERR("Control message too short: %zu", msg_len);
        send_completion_response(mctp, eid, tag_owner, msg_tag, msg, msg_len, CONTROL_COMPLETE_INVALID_LENGTH);
        return CONTROL_COMPLETE_INVALID_LENGTH;
    }

    LOG_DBG("Control message: type %u", hdr->command_code);
    int completion_code = CONTROL_COMPLETE_UNSUPPORTED_CMD;
    switch (hdr->command_code) {
        case CONTROL_MSG_SET_ENDPOINT_ID:
            completion_code = process_set_endpoint_id_control_message(mctp, eid, tag_owner, msg_tag, msg, msg_len);
            break;
        case CONTROL_MSG_GET_ENDPOINT_ID:
            completion_code = process_get_endpoint_id_control_message(mctp, eid, tag_owner, msg_tag, msg, msg_len);
            break;
        case CONTROL_MSG_GET_MCTP_VERSION_SUPPORT:
            completion_code = process_get_mctp_version_support_control_message(mctp, eid, tag_owner, msg_tag, msg, msg_len);
            break;
        case CONTROL_MSG_GET_MESSAGE_TYPE_SUPPORT:
            completion_code = process_get_message_type_support_control_message(mctp, eid, tag_owner, msg_tag, msg, msg_len);
            break;
        default:
            LOG_DBG("Unsupported control message: %u", hdr->command_code);
    }
    if (completion_code != CONTROL_COMPLETE_SUCCESS) {
        LOG_DBG("Sending Error Response: %u", completion_code);
        send_completion_response(mctp, eid, tag_owner, msg_tag, msg, msg_len, completion_code);
    }
    return completion_code;
}
```

## src/mctp_control.h
```c
/**
 * @file mctp_control.h
 * @brief MCTP Control Message Handling Header
 * 
 * This header file defines the structures and function prototypes
 * for handling MCTP control messages in a Zephyr-based MCTP endpoint.
 * It includes definitions for control message types, completion codes,
 * and function declarations for processing control messages.
 * 
 * @author Doug Sandy
 * @date January 2026
 */
#ifndef MCTP_CONTROL_H
#define MCTP_CONTROL_H

#include <stdlib.h>
#ifdef MCTP_POSIX_UNIT_TEST
#include <stdint.h>
#include <stdbool.h>
#include "libmctp.h"
/* Minimal mctp struct definitions used by the control handlers (mirrors
 * internal definitions in mctp_control.c). These are provided for unit
 * tests so test code can construct a small mctp instance.
 */
struct mctp_bus {
    mctp_eid_t eid;
};

struct mctp {
    int n_busses;
    struct mctp_bus *busses;
};
/* helper macros for test builds to access EID in the minimal mctp struct */
#define GET_EID_FROM_MCTP(mctp_ptr) (((struct mctp_bus *)(mctp_ptr->busses))->eid)
#define SET_EID_IN_MCTP(mctp_ptr, new_eid) ((((struct mctp_bus *)(mctp_ptr->busses))->eid) = (new_eid))
/* prototype used by tests to stub transport */
int mctp_message_tx(struct mctp *mctp, uint8_t remote_eid, bool tag_owner, uint8_t msg_tag, const void *msg, size_t msg_len);
/* Minimal logging macros for unit tests */
#include <stdio.h>
#define LOG_MODULE_REGISTER(name, level)
#define LOG_INF(fmt, ...) printf(fmt "\n", ##__VA_ARGS__)
#define LOG_DBG(fmt, ...) printf(fmt "\n", ##__VA_ARGS__)
#define LOG_ERR(fmt, ...) printf(fmt "\n", ##__VA_ARGS__)
#else
#include <zephyr/types.h>
#include <libmctp.h>
#include <zephyr/pmci/mctp/mctp_uart.h>
#include <zephyr/logging/log.h>
#endif

#define MCTP_CTRL_HDR_MSG_TYPE      0
#define MCTP_PLDM_HDR_MSG_TYPE      1

/* control message codes */
#define CONTROL_MSG_SET_ENDPOINT_ID 0x01
#define CONTROL_MSG_GET_ENDPOINT_ID 0x02
#define CONTROL_MSG_GET_MCTP_VERSION_SUPPORT 0x04
#define CONTROL_MSG_GET_MESSAGE_TYPE_SUPPORT 0x05

/* Control message completion codes */
#define CONTROL_COMPLETE_SUCCESS 0x00
#define CONTROL_COMPLETE_ERROR 0x01
#define CONTROL_COMPLETE_INVALID_DATA 0x02
#define CONTROL_COMPLETE_INVALID_LENGTH 0x03
#define CONTROL_COMPLETE_NOT_READY 0x04
#define CONTROL_COMPLETE_UNSUPPORTED_CMD 0x05
#define CONTROL_COMPLETE_COMMAND_SPECIFIC_START 0x80
#define CONTROL_COMPLETE_COMMAND_SPECIFIC_END 0xFF

// structure for MCTP version entry
struct mctp_version_entry {
    uint8_t major_version;
    uint8_t minor_version;
    uint8_t update_version;
    uint8_t alpha_version;
} __packed;

// send a control message using MCTP
int send_control_message(struct mctp *mctp, uint8_t eid, bool tag_owner, uint8_t msg_tag, const void *msg, size_t msg_len);

// send control completion response
void send_completion_response(struct mctp *mctp, uint8_t remote_eid, bool tag_owner, uint8_t msg_tag, const void *msg, size_t len, uint8_t completion_code);

// add a supported version for a message type
int mctp_versions_map_add(uint8_t msg_type, const struct mctp_version_entry *ver);

// get the current endpoint ID from the MCTP instance.
uint8_t get_current_endpoint_id(struct mctp *mctp);

#endif /* MCTP_CONTROL_H */
```

## src/platform.h
```c
/* platform.h - declarations for platform and FRU handlers
 *
 * This header exposes the PLDM platform handler entry points implemented
 * across the `src/platform_*.c` files and the FRU helpers in `src/fru.c`.
 */
#pragma once

#include <stddef.h>
#include <libpldm/base.h>

#ifdef __cplusplus
extern "C" {
#endif

/* Platform handler prototypes (implemented in src/platform_*.c) */
int handle_platform_get_terminus_uid(struct pldm_header_info *hdr,
                                     const void *req_msg, size_t req_len,
                                     void *resp, size_t *resp_len);

int handle_platform_set_event_receiver(struct pldm_header_info *hdr,
                                       const void *req_msg, size_t req_len,
                                       void *resp, size_t *resp_len);

int handle_platform_get_event_receiver(struct pldm_header_info *hdr,
                                       const void *req_msg, size_t req_len,
                                       void *resp, size_t *resp_len);

int handle_platform_platform_event_message(struct pldm_header_info *hdr,
                                           const void *req_msg, size_t req_len,
                                           void *resp, size_t *resp_len);

int handle_platform_poll_for_platform_event_message(struct pldm_header_info *hdr,
                                                    const void *req_msg, size_t req_len,
                                                    void *resp, size_t *resp_len);

int handle_platform_event_message_supported(struct pldm_header_info *hdr,
                                            const void *req_msg, size_t req_len,
                                            void *resp, size_t *resp_len);

int handle_platform_event_message_buffer_size(struct pldm_header_info *hdr,
                                              const void *req_msg, size_t req_len,
                                              void *resp, size_t *resp_len);

int handle_platform_set_numeric_sensor_enable(struct pldm_header_info *hdr,
                                              const void *req_msg, size_t req_len,
                                              void *resp, size_t *resp_len);

int handle_platform_get_sensor_reading(struct pldm_header_info *hdr,
                                       const void *req_msg, size_t req_len,
                                       void *resp, size_t *resp_len);

int handle_platform_get_sensor_thresholds(struct pldm_header_info *hdr,
                                          const void *req_msg, size_t req_len,
                                          void *resp, size_t *resp_len);

int handle_platform_set_sensor_thresholds(struct pldm_header_info *hdr,
                                          const void *req_msg, size_t req_len,
                                          void *resp, size_t *resp_len);

int handle_platform_restore_sensor_thresholds(struct pldm_header_info *hdr,
                                             const void *req_msg, size_t req_len,
                                             void *resp, size_t *resp_len);

int handle_platform_get_sensor_hysteresis(struct pldm_header_info *hdr,
                                          const void *req_msg, size_t req_len,
                                          void *resp, size_t *resp_len);

int handle_platform_set_sensor_hysteresis(struct pldm_header_info *hdr,
                                          const void *req_msg, size_t req_len,
                                          void *resp, size_t *resp_len);

int handle_platform_init_numeric_sensor(struct pldm_header_info *hdr,
                                        const void *req_msg, size_t req_len,
                                        void *resp, size_t *resp_len);

int handle_platform_set_state_sensor_enables(struct pldm_header_info *hdr,
                                             const void *req_msg, size_t req_len,
                                             void *resp, size_t *resp_len);

int handle_platform_get_state_sensor_readings(struct pldm_header_info *hdr,
                                              const void *req_msg, size_t req_len,
                                              void *resp, size_t *resp_len);

int handle_platform_init_state_sensor(struct pldm_header_info *hdr,
                                      const void *req_msg, size_t req_len,
                                      void *resp, size_t *resp_len);

int handle_platform_set_numeric_effecter_enable(struct pldm_header_info *hdr,
                                               const void *req_msg, size_t req_len,
                                               void *resp, size_t *resp_len);

int handle_platform_set_numeric_effecter_value(struct pldm_header_info *hdr,
                                              const void *req_msg, size_t req_len,
                                              void *resp, size_t *resp_len);

int handle_platform_get_numeric_effecter_value(struct pldm_header_info *hdr,
                                               const void *req_msg, size_t req_len,
                                               void *resp, size_t *resp_len);

int handle_platform_set_state_effecter_enables(struct pldm_header_info *hdr,
                                              const void *req_msg, size_t req_len,
                                              void *resp, size_t *resp_len);

int handle_platform_set_state_effecter_states(struct pldm_header_info *hdr,
                                             const void *req_msg, size_t req_len,
                                             void *resp, size_t *resp_len);

int handle_platform_get_state_effecter_states(struct pldm_header_info *hdr,
                                              const void *req_msg, size_t req_len,
                                              void *resp, size_t *resp_len);

int handle_platform_get_pldm_event_log_info(struct pldm_header_info *hdr,
                                           const void *req_msg, size_t req_len,
                                           void *resp, size_t *resp_len);

int handle_platform_enable_pldm_event_logging(struct pldm_header_info *hdr,
                                              const void *req_msg, size_t req_len,
                                              void *resp, size_t *resp_len);

int handle_platform_clear_pldm_event_log(struct pldm_header_info *hdr,
                                        const void *req_msg, size_t req_len,
                                        void *resp, size_t *resp_len);

int handle_platform_get_pldm_event_log_timestamp(struct pldm_header_info *hdr,
                                                 const void *req_msg, size_t req_len,
                                                 void *resp, size_t *resp_len);

int handle_platform_set_pldm_event_log_timestamp(struct pldm_header_info *hdr,
                                                 const void *req_msg, size_t req_len,
                                                 void *resp, size_t *resp_len);

int handle_platform_read_pldm_event_log(struct pldm_header_info *hdr,
                                       const void *req_msg, size_t req_len,
                                       void *resp, size_t *resp_len);

int handle_platform_get_pldm_event_log_policy_info(struct pldm_header_info *hdr,
                                                   const void *req_msg, size_t req_len,
                                                   void *resp, size_t *resp_len);

int handle_platform_set_pldm_event_log_policy(struct pldm_header_info *hdr,
                                              const void *req_msg, size_t req_len,
                                              void *resp, size_t *resp_len);

int handle_platform_find_pldm_event_log_entry(struct pldm_header_info *hdr,
                                              const void *req_msg, size_t req_len,
                                              void *resp, size_t *resp_len);

int handle_platform_get_pdr_repository_info(struct pldm_header_info *hdr,
                                           const void *req_msg, size_t req_len,
                                           void *resp, size_t *resp_len);

int handle_platform_get_pdr(struct pldm_header_info *hdr,
                            const void *req_msg, size_t req_len,
                            void *resp, size_t *resp_len);

int handle_platform_find_pdr(struct pldm_header_info *hdr,
                             const void *req_msg, size_t req_len,
                             void *resp, size_t *resp_len);

int handle_platform_run_init_agent(struct pldm_header_info *hdr,
                                   const void *req_msg, size_t req_len,
                                   void *resp, size_t *resp_len);

int handle_platform_get_pdr_repository_signature(struct pldm_header_info *hdr,
                                                 const void *req_msg, size_t req_len,
                                                 void *resp, size_t *resp_len);

/* FRU helpers (implemented in src/fru.c) */
int fru_get_metadata(struct pldm_header_info *hdr,
                     const void *req_msg, size_t req_len,
                     void *resp, size_t *resp_len);

int fru_get_record_table(struct pldm_header_info *hdr,
                         const void *req_msg, size_t req_len,
                         void *resp, size_t *resp_len);

int fru_set_record_table(struct pldm_header_info *hdr,
                         const void *req_msg, size_t req_len,
                         void *resp, size_t *resp_len);

int fru_get_record_by_option(struct pldm_header_info *hdr,
                             const void *req_msg, size_t req_len,
                             void *resp, size_t *resp_len);

#ifdef __cplusplus
}
#endif
```

## src/platform_effecter.c
```c
#include <zephyr/types.h>
#include <libmctp.h>
#include <zephyr/logging/log.h>
#include <zephyr/kernel.h>
#include <string.h>
#include <libpldm/base.h>
#include <libpldm/platform.h>
#include <libpldm/control.h>
#include <libpldm/fru.h>
#include <libpldm/pdr.h>
#include <../pldm/src/control-internal.h>
#include "pdrs/config.h"
#include "mctp_control.h"

int handle_platform_set_numeric_effecter_enable(struct pldm_header_info *hdr, const void *req_msg, size_t req_len, void *resp, size_t *resp_len)
{
	// TODO: implement
	return PLDM_ERROR_UNSUPPORTED_PLDM_CMD;
}

int handle_platform_set_numeric_effecter_value(struct pldm_header_info *hdr, const void *req_msg, size_t req_len, void *resp, size_t *resp_len)
{
	// TODO: implement
	return PLDM_ERROR_UNSUPPORTED_PLDM_CMD;
}

int handle_platform_get_numeric_effecter_value(struct pldm_header_info *hdr, const void *req_msg, size_t req_len, void *resp, size_t *resp_len)
{
	// TODO: implement
	return PLDM_ERROR_UNSUPPORTED_PLDM_CMD;
}

int handle_platform_set_state_effecter_enables(struct pldm_header_info *hdr, const void *req_msg, size_t req_len, void *resp, size_t *resp_len)
{
	// TODO: implement
	return PLDM_ERROR_UNSUPPORTED_PLDM_CMD;
}

int handle_platform_set_state_effecter_states(struct pldm_header_info *hdr, const void *req_msg, size_t req_len, void *resp, size_t *resp_len)
{
	// TODO: implement
	return PLDM_ERROR_UNSUPPORTED_PLDM_CMD;
}

int handle_platform_get_state_effecter_states(struct pldm_header_info *hdr, const void *req_msg, size_t req_len, void *resp, size_t *resp_len)
{
	// TODO: implement
	return PLDM_ERROR_UNSUPPORTED_PLDM_CMD;
}
```

## src/platform_event.c
```c
#include <zephyr/types.h>
#include <libmctp.h>
#include <zephyr/logging/log.h>
#include <zephyr/kernel.h>
#include <string.h>
#include <libpldm/base.h>
#include <libpldm/platform.h>
#include <libpldm/control.h>
#include <libpldm/fru.h>
#include <libpldm/pdr.h>
#include <../pldm/src/control-internal.h>
#include "pdrs/config.h"
#include "mctp_control.h"

int handle_platform_get_terminus_uid(struct pldm_header_info *hdr, const void *req_msg, size_t req_len, void *resp, size_t *resp_len)
{
	// TODO: implement
	return PLDM_ERROR_UNSUPPORTED_PLDM_CMD;
}

int handle_platform_set_event_receiver(struct pldm_header_info *hdr, const void *req_msg, size_t req_len, void *resp, size_t *resp_len)
{
	// TODO: implement
	return PLDM_ERROR_UNSUPPORTED_PLDM_CMD;
}

int handle_platform_get_event_receiver(struct pldm_header_info *hdr, const void *req_msg, size_t req_len, void *resp, size_t *resp_len)
{
	// TODO: implement
	return PLDM_ERROR_UNSUPPORTED_PLDM_CMD;
}

int handle_platform_platform_event_message(struct pldm_header_info *hdr, const void *req_msg, size_t req_len, void *resp, size_t *resp_len)
{
	// TODO: implement
	return PLDM_ERROR_UNSUPPORTED_PLDM_CMD;
}

int handle_platform_poll_for_platform_event_message(struct pldm_header_info *hdr, const void *req_msg, size_t req_len, void *resp, size_t *resp_len)
{
	// TODO: implement
	return PLDM_ERROR_UNSUPPORTED_PLDM_CMD;
}

int handle_platform_event_message_supported(struct pldm_header_info *hdr, const void *req_msg, size_t req_len, void *resp, size_t *resp_len)
{
	// TODO: implement
	return PLDM_ERROR_UNSUPPORTED_PLDM_CMD;
}

int handle_platform_event_message_buffer_size(struct pldm_header_info *hdr, const void *req_msg, size_t req_len, void *resp, size_t *resp_len)
{
	// TODO: implement
	return PLDM_ERROR_UNSUPPORTED_PLDM_CMD;
}
```

## src/platform_log.c
```c
#include <zephyr/types.h>
#include <libmctp.h>
#include <zephyr/logging/log.h>
#include <zephyr/kernel.h>
#include <string.h>
#include <libpldm/base.h>
#include <libpldm/platform.h>
#include <libpldm/control.h>
#include <libpldm/fru.h>
#include <libpldm/pdr.h>
#include <../pldm/src/control-internal.h>
#include "pdrs/config.h"
#include "mctp_control.h"

int handle_platform_get_pldm_event_log_info(struct pldm_header_info *hdr, const void *req_msg, size_t req_len, void *resp, size_t *resp_len)
{
	// TODO: implement
	return PLDM_ERROR_UNSUPPORTED_PLDM_CMD;
}

int handle_platform_enable_pldm_event_logging(struct pldm_header_info *hdr, const void *req_msg, size_t req_len, void *resp, size_t *resp_len)
{
	// TODO: implement
	return PLDM_ERROR_UNSUPPORTED_PLDM_CMD;
}

int handle_platform_clear_pldm_event_log(struct pldm_header_info *hdr, const void *req_msg, size_t req_len, void *resp, size_t *resp_len)
{
	// TODO: implement
	return PLDM_ERROR_UNSUPPORTED_PLDM_CMD;
}

int handle_platform_get_pldm_event_log_timestamp(struct pldm_header_info *hdr, const void *req_msg, size_t req_len, void *resp, size_t *resp_len)
{
	// TODO: implement
	return PLDM_ERROR_UNSUPPORTED_PLDM_CMD;
}

int handle_platform_set_pldm_event_log_timestamp(struct pldm_header_info *hdr, const void *req_msg, size_t req_len, void *resp, size_t *resp_len)
{
	// TODO: implement
	return PLDM_ERROR_UNSUPPORTED_PLDM_CMD;
}

int handle_platform_read_pldm_event_log(struct pldm_header_info *hdr, const void *req_msg, size_t req_len, void *resp, size_t *resp_len)
{
	// TODO: implement
	return PLDM_ERROR_UNSUPPORTED_PLDM_CMD;
}

int handle_platform_get_pldm_event_log_policy_info(struct pldm_header_info *hdr, const void *req_msg, size_t req_len, void *resp, size_t *resp_len)
{
	// TODO: implement
	return PLDM_ERROR_UNSUPPORTED_PLDM_CMD;
}

int handle_platform_set_pldm_event_log_policy(struct pldm_header_info *hdr, const void *req_msg, size_t req_len, void *resp, size_t *resp_len)
{
	// TODO: implement
	return PLDM_ERROR_UNSUPPORTED_PLDM_CMD;
}

int handle_platform_find_pldm_event_log_entry(struct pldm_header_info *hdr, const void *req_msg, size_t req_len, void *resp, size_t *resp_len)
{
	// TODO: implement
	return PLDM_ERROR_UNSUPPORTED_PLDM_CMD;
}
```

## src/platform_statesense.c
```c
#include <zephyr/types.h>
#include <libmctp.h>
#include <zephyr/logging/log.h>
#include <zephyr/kernel.h>
#include <string.h>
#include <libpldm/base.h>
#include <libpldm/platform.h>
#include <libpldm/control.h>
#include <libpldm/fru.h>
#include <libpldm/pdr.h>
#include <../pldm/src/control-internal.h>
#include "pdrs/config.h"
#include "mctp_control.h"

int handle_platform_set_state_sensor_enables(struct pldm_header_info *hdr, const void *req_msg, size_t req_len, void *resp, size_t *resp_len)
{
	// TODO: implement
	return PLDM_ERROR_UNSUPPORTED_PLDM_CMD;
}

int handle_platform_get_state_sensor_readings(struct pldm_header_info *hdr, const void *req_msg, size_t req_len, void *resp, size_t *resp_len)
{
	// TODO: implement
	return PLDM_ERROR_UNSUPPORTED_PLDM_CMD;
}

int handle_platform_init_state_sensor(struct pldm_header_info *hdr, const void *req_msg, size_t req_len, void *resp, size_t *resp_len)
{
	// TODO: implement
	return PLDM_ERROR_UNSUPPORTED_PLDM_CMD;
}
```

## src/process_pldm.h
```c
#include <zephyr/types.h>
#include <zephyr/pmci/mctp/mctp_uart.h>
#include <libmctp.h>

#ifndef INCLUDE_PROCESS_PLDM_H
#define INCLUDE_PROCESS_PLDM_H

int init_pldm();
int handle_pldm_message(struct mctp *mctp, uint8_t remote_eid, bool tag_owner, uint8_t msg_tag, const void *msg, size_t msg_len);

#endif /* INCLUDE_PROCESS_PLD_H */
```
